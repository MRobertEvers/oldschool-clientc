LUA_API_X(LUA_API_GAME_BUILD_SCENE, "game_build_scene", LUA_DOMAIN_GAME, "build_scene")
LUA_API_X(LUA_API_GAME_BUILD_SCENE_CENTERZONE, "game_build_scene_centerzone", LUA_DOMAIN_GAME, "build_scene_centerzone")
LUA_API_X(LUA_API_GAME_EXEC_PKT_PLAYER_INFO, "game_exec_pkt_player_info", LUA_DOMAIN_GAME, "exec_pkt_player_info")
LUA_API_X(LUA_API_GAME_EXEC_PKT_NPC_INFO, "game_exec_pkt_npc_info", LUA_DOMAIN_GAME, "exec_pkt_npc_info")
LUA_API_X(LUA_API_GAME_EXEC_PKT_IF_SETTAB, "game_exec_pkt_if_settab", LUA_DOMAIN_GAME, "exec_pkt_if_settab")
LUA_API_X(LUA_API_GAME_EXEC_PKT_UPDATE_INV_FULL, "game_exec_pkt_update_inv_full", LUA_DOMAIN_GAME, "exec_pkt_update_inv_full")
LUA_API_X(LUA_API_GAME_GET_INV_OBJ_IDS, "game_get_inv_obj_ids", LUA_DOMAIN_GAME, "get_inv_obj_ids")
LUA_API_X(LUA_API_GAME_LOAD_INTERFACES, "game_load_interfaces", LUA_DOMAIN_GAME, "load_interfaces")
LUA_API_X(LUA_API_GAME_LOAD_COMPONENT_SPRITES, "game_load_component_sprites", LUA_DOMAIN_GAME, "load_component_sprites")
LUA_API_X(LUA_API_GAME_GET_INTERFACE_MODEL_IDS, "game_get_interface_model_ids", LUA_DOMAIN_GAME, "get_interface_model_ids")
LUA_API_X(LUA_API_GAME_GET_HEAP_USAGE_MB, "game_get_heap_usage_mb", LUA_DOMAIN_GAME, "get_heap_usage_mb")
LUA_API_X(LUA_API_GAME_REBUILD_CENTERZONE_BEGIN, "game_rebuild_centerzone_begin", LUA_DOMAIN_GAME, "rebuild_centerzone_begin")
LUA_API_X(LUA_API_GAME_REBUILD_CENTERZONE_CHUNK, "game_rebuild_centerzone_chunk", LUA_DOMAIN_GAME, "rebuild_centerzone_chunk")
LUA_API_X(LUA_API_GAME_REBUILD_CENTERZONE_END, "game_rebuild_centerzone_end", LUA_DOMAIN_GAME, "rebuild_centerzone_end")
LUA_API_X(LUA_API_GAME_REBUILD_CENTERZONE_SLOW, "game_rebuild_centerzone_slow", LUA_DOMAIN_GAME, "rebuild_centerzone_slow")
LUA_API_X(LUA_API_GAME_SPAWN_ELEMENT, "game_spawn_element", LUA_DOMAIN_GAME, "spawn_element")
