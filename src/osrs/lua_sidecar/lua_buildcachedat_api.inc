/* Included only from lua_api.h / lua_api.c when LUA_API_X is defined. */
LUA_API_X(LUA_API_BUILDCACHEDAT_MAP_SCENERY_CACHE_ADD, "buildcachedat_map_scenery_cache_add", LUA_DOMAIN_BUILDCACHEDAT, "map_scenery_cache_add")
LUA_API_X(LUA_API_BUILDCACHEDAT_SET_CONFIG_JAGFILE, "buildcachedat_set_config_jagfile", LUA_DOMAIN_BUILDCACHEDAT, "set_config_jagfile")
LUA_API_X(LUA_API_BUILDCACHEDAT_INIT_VARP_VARBIT_FROM_CONFIG_JAGFILE, "buildcachedat_init_varp_varbit_from_config_jagfile", LUA_DOMAIN_BUILDCACHEDAT, "init_varp_varbit_from_config_jagfile")
LUA_API_X(LUA_API_BUILDCACHEDAT_SET_VERSIONLIST_JAGFILE, "buildcachedat_set_versionlist_jagfile", LUA_DOMAIN_BUILDCACHEDAT, "set_versionlist_jagfile")
LUA_API_X(LUA_API_BUILDCACHEDAT_MAP_TERRAIN_CACHE_ADD, "buildcachedat_map_terrain_cache_add", LUA_DOMAIN_BUILDCACHEDAT, "map_terrain_cache_add")
LUA_API_X(LUA_API_BUILDCACHEDAT_HAS_MAP_TERRAIN, "buildcachedat_has_map_terrain", LUA_DOMAIN_BUILDCACHEDAT, "has_map_terrain")
LUA_API_X(LUA_API_BUILDCACHEDAT_HAS_MAP_SCENERY, "buildcachedat_has_map_scenery", LUA_DOMAIN_BUILDCACHEDAT, "has_map_scenery")
LUA_API_X(LUA_API_BUILDCACHEDAT_MODEL_CACHE_HAS, "buildcachedat_model_cache_has", LUA_DOMAIN_BUILDCACHEDAT, "model_cache_has")
LUA_API_X(LUA_API_BUILDCACHEDAT_ANIMBASEFRAMES_CACHE_HAS, "buildcachedat_animbaseframes_cache_has", LUA_DOMAIN_BUILDCACHEDAT, "animbaseframes_cache_has")
LUA_API_X(LUA_API_BUILDCACHEDAT_FLOORTYPES_INIT_FROM_CONFIG_JAGFILE, "buildcachedat_floortypes_init_from_config_jagfile", LUA_DOMAIN_BUILDCACHEDAT, "floortypes_init_from_config_jagfile")
LUA_API_X(LUA_API_BUILDCACHEDAT_INIT_SCENERY_CONFIGS_FROM_CONFIG_JAGFILE, "buildcachedat_init_scenery_configs_from_config_jagfile", LUA_DOMAIN_BUILDCACHEDAT, "init_scenery_configs_from_config_jagfile")
LUA_API_X(LUA_API_BUILDCACHEDAT_GET_ALL_SCENERY_LOCS, "buildcachedat_get_all_scenery_locs", LUA_DOMAIN_BUILDCACHEDAT, "get_all_scenery_locs")
LUA_API_X(LUA_API_BUILDCACHEDAT_GET_SCENERY_MODEL_IDS, "buildcachedat_get_scenery_model_ids", LUA_DOMAIN_BUILDCACHEDAT, "get_scenery_model_ids")
LUA_API_X(LUA_API_BUILDCACHEDAT_GET_ALL_UNIQUE_SCENERY_MODEL_IDS, "buildcachedat_get_all_unique_scenery_model_ids", LUA_DOMAIN_BUILDCACHEDAT, "get_all_unique_scenery_model_ids")
LUA_API_X(LUA_API_BUILDCACHEDAT_GET_NPC_MODEL_IDS, "buildcachedat_get_npc_model_ids", LUA_DOMAIN_BUILDCACHEDAT, "get_npc_model_ids")
LUA_API_X(LUA_API_BUILDCACHEDAT_GET_NPC_HEAD_MODEL_IDS, "buildcachedat_get_npc_head_model_ids", LUA_DOMAIN_BUILDCACHEDAT, "get_npc_head_model_ids")
LUA_API_X(LUA_API_BUILDCACHEDAT_GET_IDK_MODEL_IDS, "buildcachedat_get_idk_model_ids", LUA_DOMAIN_BUILDCACHEDAT, "get_idk_model_ids")
LUA_API_X(LUA_API_BUILDCACHEDAT_GET_IDK_HEAD_MODEL_IDS, "buildcachedat_get_idk_head_model_ids", LUA_DOMAIN_BUILDCACHEDAT, "get_idk_head_model_ids")
LUA_API_X(LUA_API_BUILDCACHEDAT_GET_OBJ_MODEL_IDS, "buildcachedat_get_obj_model_ids", LUA_DOMAIN_BUILDCACHEDAT, "get_obj_model_ids")
LUA_API_X(LUA_API_BUILDCACHEDAT_GET_OBJ_HEAD_MODEL_IDS, "buildcachedat_get_obj_head_model_ids", LUA_DOMAIN_BUILDCACHEDAT, "get_obj_head_model_ids")
LUA_API_X(LUA_API_BUILDCACHEDAT_GET_OBJ, "buildcachedat_get_obj", LUA_DOMAIN_BUILDCACHEDAT, "get_obj")
LUA_API_X(LUA_API_BUILDCACHEDAT_GET_PLAYER_APPEARANCE_IDS_FROM_PACKET, "buildcachedat_get_player_appearance_ids_from_packet", LUA_DOMAIN_BUILDCACHEDAT, "get_player_appearance_ids_from_packet")
LUA_API_X(LUA_API_BUILDCACHEDAT_GET_NPC_IDS_FROM_PACKET, "buildcachedat_get_npc_ids_from_packet", LUA_DOMAIN_BUILDCACHEDAT, "get_npc_ids_from_packet")
LUA_API_X(LUA_API_BUILDCACHEDAT_MODEL_CACHE_ADD, "buildcachedat_model_cache_add", LUA_DOMAIN_BUILDCACHEDAT, "model_cache_add")
LUA_API_X(LUA_API_BUILDCACHEDAT_LOAD_INTERFACES, "buildcachedat_load_interfaces", LUA_DOMAIN_BUILDCACHEDAT, "load_interfaces")
LUA_API_X(LUA_API_BUILDCACHEDAT_SEQUENCES_INIT_FROM_CONFIG_JAGFILE, "buildcachedat_sequences_init_from_config_jagfile", LUA_DOMAIN_BUILDCACHEDAT, "sequences_init_from_config_jagfile")
LUA_API_X(LUA_API_BUILDCACHEDAT_GET_ANIMBASEFRAMES_COUNT_FROM_VERSIONLIST_JAGFILE, "buildcachedat_get_animbaseframes_count_from_versionlist_jagfile", LUA_DOMAIN_BUILDCACHEDAT, "get_animbaseframes_count_from_versionlist_jagfile")
LUA_API_X(LUA_API_BUILDCACHEDAT_ANIMBASEFRAMES_CACHE_ADD, "buildcachedat_animbaseframes_cache_add", LUA_DOMAIN_BUILDCACHEDAT, "animbaseframes_cache_add")
LUA_API_X(LUA_API_BUILDCACHEDAT_IDKITS_INIT_FROM_CONFIG_JAGFILE, "buildcachedat_idkits_init_from_config_jagfile", LUA_DOMAIN_BUILDCACHEDAT, "idkits_init_from_config_jagfile")
LUA_API_X(LUA_API_BUILDCACHEDAT_OBJECTS_INIT_FROM_CONFIG_JAGFILE, "buildcachedat_objects_init_from_config_jagfile", LUA_DOMAIN_BUILDCACHEDAT, "objects_init_from_config_jagfile")
LUA_API_X(LUA_API_BUILDCACHEDAT_SET_2D_MEDIA_JAGFILE, "buildcachedat_set_2d_media_jagfile", LUA_DOMAIN_BUILDCACHEDAT, "set_2d_media_jagfile")
LUA_API_X(LUA_API_BUILDCACHEDAT_CACHE_TEXTURES, "buildcachedat_cache_textures", LUA_DOMAIN_BUILDCACHEDAT, "cache_textures")
LUA_API_X(LUA_API_BUILDCACHEDAT_CACHE_TITLE, "buildcachedat_cache_title", LUA_DOMAIN_BUILDCACHEDAT, "cache_title")
LUA_API_X(LUA_API_BUILDCACHEDAT_CACHE_MEDIA, "buildcachedat_cache_media", LUA_DOMAIN_BUILDCACHEDAT, "cache_media")
LUA_API_X(LUA_API_BUILDCACHEDAT_LOAD_COMPONENT_SPRITES_FROM_MEDIA, "buildcachedat_load_component_sprites_from_media", LUA_DOMAIN_BUILDCACHEDAT, "load_component_sprites_from_media")
LUA_API_X(LUA_API_BUILDCACHEDAT_FINALIZE_SCENE, "buildcachedat_finalize_scene", LUA_DOMAIN_BUILDCACHEDAT, "finalize_scene")
LUA_API_X(LUA_API_BUILDCACHEDAT_COMPONENT_CACHE_CLEAR, "buildcachedat_component_cache_clear", LUA_DOMAIN_BUILDCACHEDAT, "component_cache_clear")
LUA_API_X(LUA_API_BUILDCACHEDAT_CLEAR_MAP_CHUNKS, "buildcachedat_clear_map_chunks", LUA_DOMAIN_BUILDCACHEDAT, "clear_map_chunks")
LUA_API_X(LUA_API_BUILDCACHEDAT_MODEL_CACHE_CLEAR, "buildcachedat_model_cache_clear", LUA_DOMAIN_BUILDCACHEDAT, "model_cache_clear")
LUA_API_X(LUA_API_BUILDCACHEDAT_CLEAR_CONFIG_JAGFILE, "buildcachedat_clear_config_jagfile", LUA_DOMAIN_BUILDCACHEDAT, "clear_config_jagfile")
LUA_API_X(LUA_API_BUILDCACHEDAT_CLEAR_VERSIONLIST_JAGFILE, "buildcachedat_clear_versionlist_jagfile", LUA_DOMAIN_BUILDCACHEDAT, "clear_versionlist_jagfile")
LUA_API_X(LUA_API_BUILDCACHEDAT_CLEAR_MEDIA_JAGFILE, "buildcachedat_clear_media_jagfile", LUA_DOMAIN_BUILDCACHEDAT, "clear_media_jagfile")
LUA_API_X(LUA_API_BUILDCACHEDAT_CLEAR, "buildcachedat_clear", LUA_DOMAIN_BUILDCACHEDAT, "clear")
LUA_API_X(LUA_API_BUILDCACHEDAT_SCENERY_CONFIG_LOAD_MAPCHUNK_FROM_CONFIG_JAGFILE, "buildcachedat_scenery_config_load_mapchunk_from_config_jagfile", LUA_DOMAIN_BUILDCACHEDAT, "scenery_config_load_mapchunk_from_config_jagfile")
LUA_API_X(LUA_API_BUILDCACHEDAT_SCENERY_CONFIG_GET_MODEL_IDS_MAPCHUNK, "buildcachedat_scenery_config_get_model_ids_mapchunk", LUA_DOMAIN_BUILDCACHEDAT, "scenery_config_get_model_ids_mapchunk")
LUA_API_X(LUA_API_BUILDCACHEDAT_SCENERY_CONFIG_GET_ANIMBASEFRAMES_IDS_MAPCHUNK, "buildcachedat_scenery_config_get_animbaseframes_ids_mapchunk", LUA_DOMAIN_BUILDCACHEDAT, "scenery_config_get_animbaseframes_ids_mapchunk")
LUA_API_X(LUA_API_BUILDCACHEDAT_ANIMBASEFRAMES_CACHE_CLEAR, "buildcachedat_animbaseframes_cache_clear", LUA_DOMAIN_BUILDCACHEDAT, "animbaseframes_cache_clear")
LUA_API_X(LUA_API_BUILDCACHEDAT_SCENERY_CONFIG_CLEAR, "buildcachedat_scenery_config_clear", LUA_DOMAIN_BUILDCACHEDAT, "scenery_config_clear")
LUA_API_X(LUA_API_BUILDCACHEDAT_SEQUENCES_CLEAR, "buildcachedat_sequences_clear", LUA_DOMAIN_BUILDCACHEDAT, "sequences_clear")
LUA_API_X(LUA_API_BUILDCACHEDAT_MAP_SCENERY_CACHE_CLEAR, "buildcachedat_map_scenery_cache_clear", LUA_DOMAIN_BUILDCACHEDAT, "map_scenery_cache_clear")
LUA_API_X(LUA_API_BUILDCACHEDAT_MAP_TERRAIN_CACHE_CLEAR, "buildcachedat_map_terrain_cache_clear", LUA_DOMAIN_BUILDCACHEDAT, "map_terrain_cache_clear")
LUA_API_X(LUA_API_BUILDCACHEDAT_FLOORTYPES_CLEAR, "buildcachedat_floortypes_clear", LUA_DOMAIN_BUILDCACHEDAT, "floortypes_clear")
LUA_API_X(LUA_API_BUILDCACHEDAT_OBJECTS_CLEAR, "buildcachedat_objects_clear", LUA_DOMAIN_BUILDCACHEDAT, "objects_clear")
