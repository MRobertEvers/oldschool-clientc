LUA_API_X(LUA_API_UI_LOAD_REVCONFIG, "ui_load_revconfig", LUA_DOMAIN_UI, "load_revconfig")
LUA_API_X(LUA_API_UI_LOAD_FONTS, "ui_load_fonts", LUA_DOMAIN_UI, "load_fonts")
LUA_API_X(LUA_API_UI_LOAD_RS_COMPONENTS, "ui_load_rs_components", LUA_DOMAIN_UI, "load_rs_components")
LUA_API_X(LUA_API_UI_RESOLVE_INV_SPRITES, "ui_resolve_inv_sprites", LUA_DOMAIN_UI, "resolve_inv_sprites")
LUA_API_X(LUA_API_UI_PARSE_REVCONFIG, "ui_parse_revconfig", LUA_DOMAIN_UI, "parse_revconfig")
LUA_API_X(LUA_API_UI_GET_REVCONFIG_INV_OBJ_IDS, "ui_get_revconfig_inv_obj_ids", LUA_DOMAIN_UI, "get_revconfig_inv_obj_ids")
LUA_API_X(LUA_API_UI_LOAD_REVCONFIG_INVENTORIES, "ui_load_revconfig_inventories", LUA_DOMAIN_UI, "load_revconfig_inventories")
LUA_API_X(LUA_API_UI_LOAD_REVCONFIG_UI, "ui_load_revconfig_ui", LUA_DOMAIN_UI, "load_revconfig_ui")
